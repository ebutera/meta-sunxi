## conf/layer.conf
```bitbake
# We have a conf and classes directory, append to BBPATH
BBPATH .= ":${LAYERDIR}"

# We have a recipes directory, add to BBFILES
BBFILES += "${LAYERDIR}/recipes*/*/*.bb ${LAYERDIR}/recipes*/*/*.bbappend"

BBFILE_COLLECTIONS += "meta-sunxi"
BBFILE_PATTERN_meta-sunxi := "^${LAYERDIR}/"
BBFILE_PRIORITY_meta-sunxi = "10"
```

## conf/machine/allwinner-a10.conf
```bitbake
#@TYPE: Machine
#@NAME: Allwinner A10 machine
#@DESCRIPTION: Machine configuration for the Allwinner A10 boards

PREFERRED_PROVIDER_virtual/xserver = "xserver-xorg"
XSERVER = "xserver-xorg \
           xf86-input-evdev \
           xf86-input-mouse \
           xf86-input-keyboard"

# Only has DVI connector for external screen
GUI_MACHINE_CLASS = "bigscreen"

DEFAULTTUNE="cortexa8hf-neon"

require conf/machine/include/tune-cortexa8.inc

PREFERRED_PROVIDER_virtual/kernel = "linux"
PREFERRED_VERSION_linux-libc-headers = "3.0.8"

KERNEL_IMAGETYPE = "uImage"

UBOOT_MACHINE = "sun4i"
UBOOT_ENTRYPOINT = "0x40008000"
UBOOT_LOADADDRESS = "0x40008000"

SPL_BINARY = "sun4i-spl.bin"

IMAGE_FSTYPES += "tar.bz2 squashfs"

# Guesswork
SERIAL_CONSOLE = "115200 ttyS0"

#EXTRA_IMAGECMD_jffs2 = "-lnp -e 0x40000 -s 4096"

MACHINE_FEATURES = "kernel26 screen apm usbgadget usbhost vfat alsa"
```

## conf/machine/bananapi-m64.conf
```bitbake
#@TYPE: Machine
#@NAME: pine64-plus
#@DESCRIPTION: Machine configuration for the pine64-plus, based on Allwinner A64 CPU

require conf/machine/include/sun50i.inc

KERNEL_DEVICETREE = "allwinner/sun50i-a64-bananapi-m64.dtb"
UBOOT_MACHINE = "bananapi_m64_defconfig"
```

## conf/machine/cubieboard.conf
```bitbake
#@TYPE: Machine
#@NAME: CubieBoard
#@DESCRIPTION: Machine configuration for the cubieboard, based on allwinner a10 CPU http://cubieboard.org/

require conf/machine/include/sun4i.inc

UBOOT_MACHINE = "Cubieboard_config"
SUNXI_FEX_FILE = "sys_config/a10/cubieboard.fex"
```

## conf/machine/cubieboard2.conf
```bitbake
#@TYPE: Machine
#@NAME: CubieBoard2
#@DESCRIPTION: Machine configuration for the cubieboard2, based on allwinner A20 CPU http://cubieboard.org/

require conf/machine/include/sun7i.inc

UBOOT_MACHINE = "Cubieboard_config"
SUNXI_FEX_FILE = "sys_config/a20/cubieboard2.fex"
```

## conf/machine/cubietruck.conf
```bitbake
#@TYPE: Machine
#@NAME: Cubietruck
#@DESCRIPTION: Machine configuration for the Cubietruck, based on allwinner A20 CPU http://cubieboard.org/

require conf/machine/include/sun7i.inc

UBOOT_MACHINE = "Cubietruck_config"
SUNXI_FEX_FILE = "sys_config/a20/cubietruck.fex"
```

## conf/machine/forfun-q88db.conf
```bitbake
#@TYPE: Machine
#@NAME: Forfun Q88DB
#@DESCRIPTION: Machine configuration for the Forfun Q88DB Tablet with A13 CPU
#http://linux-sunxi.org/Forfun_Q88DB

require conf/machine/include/sun5i.inc

UBOOT_MACHINE = "forfun_q88db_defconfig"
SUNXI_FEX_FILE = "sys_config/a13/forfun_q88db.fex"
```

## conf/machine/include/hardware/ap6212a.inc
```bitbake
# Include for boards with AMPAK 6212A Wifi / Bluetooth module
# https://linux-sunxi.org/Wifi#Ampak

MACHINE_EXTRA_RRECOMMENDS_append = " kernel-module-brcmfmac"
MACHINE_EXTRA_RDEPENDS_append = " linux-firmware-bcm43430"
```

## conf/machine/include/sun50i.inc
```bitbake
require conf/machine/include/sunxi64.inc

DEFAULTTUNE ?= "cortexa53-crypto"
require conf/machine/include/arm/armv8a/tune-cortexa53.inc

SOC_FAMILY = "sun50i"
```

## conf/machine/include/sun5i.inc
```bitbake
require conf/machine/include/sunxi.inc
require conf/machine/include/sunxi-mali.inc
require conf/machine/include/arm/armv8a/tune-cortexa8.inc

SOC_FAMILY = "sun5i"
```

## conf/machine/include/sunxi-mali.inc
```bitbake
# The "sunxi-mailine-graphics-drivers.inc" doesn't exist, but it can be created
# in the future if needed.  Using include directive ensures build doesn't fail
# if .inc file doesn't exist:
# https://www.yoctoproject.org/pipermail/yocto/2019-August/046484.html
include ${@'sunxi-mali-driver.inc' if 'use-mailine-graphics' not in d.getVar("MACHINEOVERRIDES").split(":") else 'sunxi-mailine-graphics-drivers.inc' }
```

## conf/machine/include/sunxi.inc
```bitbake
PREFERRED_PROVIDER_virtual/xserver = "xserver-xorg"
XSERVER = "xserver-xorg \
           xf86-video-fbturbo \
           xf86-input-evdev \
           xf86-input-mouse \
           xf86-input-keyboard"

PREFERRED_PROVIDER_virtual/kernel = "linux-mainline"
PREFERRED_VERSION_linux-sunxi ?= "3.4.%"
PREFERRED_VERSION_linux-libc-headers = "3.4.61"
PREFERRED_PROVIDER_u-boot = "u-boot-mainline"
PREFERRED_PROVIDER_virtual/bootloader = "u-boot-mainline"

KERNEL_IMAGETYPE = "uImage"

IMAGE_CLASSES += "sdcard_image-sunxi"
IMAGE_FSTYPES += "ext3 tar.gz sunxi-sdimg"

MACHINE_EXTRA_RRECOMMENDS = "kernel-modules"

UBOOT_LOCALVERSION = "-g${@d.getVar('SRCPV', True).partition('+')[2][0:7]}"
```

## conf/machine/mele.conf
```bitbake
#@TYPE: Machine
#@NAME: Mele a1000/a2000
#@DESCRIPTION: Machine configuration for the Mele a1000 and a2000, base on allwinner a10 CPU

# Only has DVI connector for external screen
GUI_MACHINE_CLASS = "bigscreen"

require conf/machine/include/tune-cortexa8.inc
require conf/machine/include/sunxi.inc
require conf/machine/include/sunxi-mali.inc

UBOOT_MACHINE = "Mele_A1000_config"
UBOOT_ENTRYPOINT = "0x40008000"
UBOOT_LOADADDRESS = "0x40008000"

SERIAL_CONSOLE = "115200 ttyS0"

MACHINE_FEATURES = "kernel26 screen apm usbgadget usbhost vfat alsa"
```

## conf/machine/meleg.conf
```bitbake
#@TYPE: Machine
#@NAME: Mele a1000g/a2000g
#@DESCRIPTION: Machine configuration for the Mele a1000g and a2000g, base on allwinner a10 CPU

require conf/machine/include/sun4i.inc

UBOOT_MACHINE = "Mele_A1000G_config"
SUNXI_FEX_FILE = "sys_config/a10/mele_a1000g.fex"
```

## conf/machine/nanopi-duo2.conf
```bitbake
#@TYPE: Machine
#@NAME: nanopi-duo2
#@DESCRIPTION: Machine configuration for the FriendlyARM NanoPi Duo2, based on the Allwinner H3 CPU

require conf/machine/include/sun8i.inc

KERNEL_DEVICETREE = "sun8i-h3-nanopi-duo2.dtb"
UBOOT_MACHINE = "nanopi_duo2_defconfig"
```

## conf/machine/nanopi-m1-plus.conf
```bitbake
#@TYPE: Machine
#@NAME: nanopi M1 Plus
#@DESCRIPTION: Machine configuration for the FriendlyARM NanoPi Neo, based on the Allwinner H3 CPU

require conf/machine/include/sun8i.inc

PREFERRED_VERSION_u-boot = "v2018.09%"

KERNEL_DEVICETREE = "sun8i-h3-nanopi-m1-plus.dtb"
UBOOT_MACHINE = "nanopi_m1_plus_defconfig"
```

## conf/machine/nanopi-neo-air.conf
```bitbake
#@TYPE: Machine
#@NAME: nanopi-neo-air
#@DESCRIPTION: Machine configuration for the FriendlyARM NanoPi Neo Air, based
# on the Allwinner H3 CPU.

require conf/machine/include/sun8i.inc

PREFERRED_VERSION_u-boot = "v2017.11%"

KERNEL_DEVICETREE = "sun8i-h3-nanopi-neo-air.dtb"
UBOOT_MACHINE = "nanopi_neo_air_defconfig"
```

## conf/machine/nanopi-neo-plus2.conf
```bitbake
#@TYPE: Machine
#@NAME: nanopi-neo-plus2
#@DESCRIPTION: Machine configuration for the FriendlyARM NanoPi Neo Plus2, based
# on the Allwinner H5 SoC.

require conf/machine/include/sun50i.inc

KERNEL_DEVICETREE = "allwinner/sun50i-h5-nanopi-neo-plus2.dtb"
UBOOT_MACHINE = "nanopi_neo_plus2_defconfig"
```

## conf/machine/nanopi-neo.conf
```bitbake
#@TYPE: Machine
#@NAME: nanopi-neo
#@DESCRIPTION: Machine configuration for the FriendlyARM NanoPi Neo, based on the Allwinner H3 CPU

require conf/machine/include/sun8i.inc

PREFERRED_VERSION_u-boot = "v2018.09%"

KERNEL_DEVICETREE = "sun8i-h3-nanopi-neo.dtb"
UBOOT_MACHINE = "nanopi_neo_defconfig"
```

## conf/machine/nanopi-neo2.conf
```bitbake
#@TYPE: Machine
#@NAME: nanopi-neo2
#@DESCRIPTION: Machine configuration for the FriendlyARM NanoPi Neo 2, based on
# the Allwinner H5 SoC.

require conf/machine/include/sun50i.inc

KERNEL_DEVICETREE = "allwinner/sun50i-h5-nanopi-neo2.dtb"
UBOOT_MACHINE = "nanopi_neo2_defconfig"
```

## conf/machine/nanopi-r1.conf
```bitbake
#@TYPE: Machine
#@NAME: NanoPi R1
#@DESCRIPTION: Machine configuration for the FriendlyARM NanoPi R1, based on #the Allwinner H3 CPU

require conf/machine/include/sun8i.inc

KERNEL_DEVICETREE = "sun8i-h3-nanopi-r1.dtb"
UBOOT_MACHINE = "nanopi_r1_defconfig"
```

## conf/machine/olinuxino-a10.conf
```bitbake
#@TYPE: Machine
#@NAME: Olimex A10-OLinuXino-LIME Board
#@DESCRIPTION: Machine configuration for Olimex A10-OLinuXino-LIME Board, based on Allwinner A10 CPU
#https://github.com/OLIMEX/OLINUXINO

require conf/machine/include/sun4i.inc

UBOOT_MACHINE = "A10-OLinuXino-Lime_config"
SUNXI_FEX_FILE = "sys_config/a10/a10-olinuxino-lime.fex"
```

## conf/machine/olinuxino-a10lime.conf
```bitbake
#@TYPE: Machine
#@NAME: Olimex A10-OLinuXino Lime (4GB) Board
#@DESCRIPTION: Machine configuration for the Olimex A10-OLinuXino Lime Board, based on Allwinner A10 CPU
#https://github.com/OLIMEX/OLINUXINO

require conf/machine/include/tune-cortexa8.inc
require conf/machine/include/sunxi.inc
require conf/machine/include/sunxi-mali.inc

UBOOT_MACHINE = "A10-OLinuXino-Lime_config"
UBOOT_ENTRYPOINT = "0x40008000"
UBOOT_LOADADDRESS = "0x40008000"

SERIAL_CONSOLE = "115200 ttyS0"

MACHINE_FEATURES = "kernel26 screen apm usbgadget usbhost vfat alsa"
```

## conf/machine/olinuxino-a10s.conf
```bitbake
#@TYPE: Machine
#@NAME: Olimex A10S-OLinuXino-MICRO Board
#@DESCRIPTION: Machine configuration for Olimex A10S-OLinuXino-MICRO Board, based on Allwinner A10s CPU
#https://github.com/OLIMEX/OLINUXINO

require conf/machine/include/sun5i.inc

UBOOT_MACHINE = "A10s-OLinuXino-Micro_config"
SUNXI_FEX_FILE = "sys_config/a10s/a10s-olinuxino-m.fex"
```

## conf/machine/olinuxino-a13.conf
```bitbake
#@TYPE: Machine
#@NAME: Olimex A13-OLinuXino Board
#@DESCRIPTION: Machine configuration for the Olime A13-OLinuXino Board, base on allwinner a13 CPU
#https://github.com/OLIMEX/OLINUXINO

# Only has DVI connector for external screen
GUI_MACHINE_CLASS = "bigscreen"

require conf/machine/include/tune-cortexa8.inc
require conf/machine/include/sunxi.inc
require conf/machine/include/sunxi-mali.inc

UBOOT_MACHINE = "A13-OLinuXino_config"
UBOOT_ENTRYPOINT = "0x40008000"
UBOOT_LOADADDRESS = "0x40008000"

KERNEL_DEVICETREE = "sun5i-a13-olinuxino.dtb"

SERIAL_CONSOLE = "115200 ttyS0"

MACHINE_FEATURES = "kernel26 screen apm usbgadget usbhost vfat alsa"
```
